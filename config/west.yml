## config/west.yml
```yaml
manifest:
  remotes:
    - name: antler5
      url-base: https://github.com/antler5
  projects:
    - name: zmk
      remote: antler5
      revision: split-combos
      import: app/west.yml
  self:
    path: config
```
